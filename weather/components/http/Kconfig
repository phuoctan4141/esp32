## weather/components/http/Kconfig
```kconfig
menu "HTTP Connection Configuration"

    orsource "$IDF_PATH/examples/common_components/env_caps/$IDF_TARGET/Kconfig.env_caps"

    config WEB_SERVER
        string "WEB SERVER"
        default "api.openweathermap.org"
        help
            WEB SERVER.
    
    config WEB_PORT
        string "WEB PORT"
        default "80"
        help
            WEB PORT.

    config WEB_URL
        string "WEB URL"
        default "http://api.openweathermap.org/data/2.5/weather"
        help
            WEB URL.

    config LAT
        string "Latitude"
        default "10.699268"
        help
            Latitude.
    
    config LON
        string "Longitude"
        default "105.117681"
        help
            Longitude.
    
    config OPENWEATHERMAP_API_KEY
        string "OPENWEATHERMAP API KEY"
        default "26594138afb8818b4b282af47a43f43d"
        help
            OPENWEATHERMAP API KEY
      

endmenu
```

## weather_quantized/components/wifi/Kconfig
```kconfig
menu "Wi-Fi Connection Configuration"

    orsource "$IDF_PATH/examples/common_components/env_caps/$IDF_TARGET/Kconfig.env_caps"

    config WIFI_SSID
        string "WiFi SSID"
        default "Thao"
        help
            SSID (network name) for the example to connect to.
    
    config WIFI_PASSWORD
        string "WiFi Password"
        default "13ThiThao"
        help
            WiFi password (WPA or WPA2) for the example to use.
            Can be left blank if the network has no security set.

    config WIFI_CONN_MAX_RETRY
        int "Maximum retry"
        default 5
        help
            Set the Maximum retry to avoid station reconnecting to the AP unlimited,
            in case the AP is really inexistent.


endmenu
```
